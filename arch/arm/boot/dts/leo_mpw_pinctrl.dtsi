
#include <dt-bindings/gpio/gpio.h>
#include <dt-bindings/interrupt-controller/irq.h>

/ {
	pinctrl_0: pinctrl@0x2305000 {
	compatible = "nationalchip,LEO_A7-pinctrl";
	reg = <0x2305000 0x90>;
	interrupt-parent = <&intc>;
	interrupts = <13>;
		gpa0: gpa0 {
			gpio-controller;
			#gpio-cells = <2>;
			interrupt-parent = <&intc>;
			interrupt-controller;
			#interrupt-cells = <2>;

			nationalchip,base_offset = <0x0>;
			nationalchip,reg_offset  = <0x0 0x08 0x10 0x18 0x2c 0x34 0x3c 0x44 0x4c 0x54 0x5c 0x64 0x6c 0x74>;
			nationalchip,cfg_width   = <  1	   1	1	 1 	  1    1    1	 1	  1	   1    1    1    1    1>;
			nationalchip,nr_pins     = <32>;
		};

		gpa1: gpa1 {
			gpio-controller;
			#gpio-cells = <2>;
			interrupt-parent = <&intc>;
			interrupt-controller;
			#interrupt-cells = <2>;

			nationalchip,base_offset = <4>;
			nationalchip,reg_offset  = <0x0 0x08 0x10 0x18 0x2c 0x34 0x3c 0x44 0x4c 0x54 0x5c 0x64 0x6c 0x74>;
			nationalchip,cfg_width   = <  1	   1	1	 1 	  1    1    1	 1	  1	   1    1    1    1    1>;
			nationalchip,nr_pins = <18>;
		};
	};
};
