
&ck_i2c0 {
	axp2585@34 {
		status = "okay";
		device_type = "pmu0";
		compatible = "axp, axp2585";
		reg = <0x34>;
		ax2585_chg-gpio = <&gpa0 16 GPIO_ACTIVE_HIGH>;
		axp2585_chg_gpio_names = "ax2585-chg";
		//ax2585_fg-gpio = <&gpio GPIOZ_1 GPIO_ACTIVE_HIGH>;
		//axp2585_fg_gpio_names = "ax2585-fg";
		pmu_id = <0x9>;
		pmu_vbusen_func = <0x0>;
		pmu_reset = <0x0>;
		pmu_irq_wakeup = <0x1>;
		pmu_hot_shutdown = <0x1>;
		pmu_inshort = <0x1>;
		powerkey@0 {
			status = "disabled";
			device_type = "powerkey0";
			compatible = "axp, axp2585-powerkey";
		};
		charger@0 {
			status = "okay";
			device_type = "charger0";
			compatible = "axp, axp2585-charger";
			pmu_SDP_vbus_currentlimit = <0x3E8>;  //1000mA
			pmu_SDP_Cbat_currentlimit = <0x3E8>;  //1000ma
			pmu_CDP_vbus_currentlimit = <0x3E8>;  //1000ma
			pmu_CDP_Cbat_currentlimit = <0x3E8>;  //1000ma
			pmu_DCP_vbus_currentlimit = <0x9C4>;  //2500ma
			pmu_DCP_Cbat_currentlimit = <0x9C4>;  //2500ma
			pmu_chg_ic_temp = <0x0>;
			pmu_battery_rdc = <0x64>;
			pmu_battery_cap = <0xfa0>; //4000mAh
			pmu_runtime_chgcur = <0x1F4>;
			pmu_suspend_chgcur = <0x5dc>;
			pmu_shutdown_chgcur = <0x5dc>;
			pmu_init_chgvol = <0x1068>;
			pmu_on_ctl = <0x9>;
			pmu_boost_en = <0x1>;
			pmu_boost_cur_limit = <0x5dc>;
			pmu_boost_vol_limit = <0x1406>;
			pmu_boost_vol_hold = <0xa28>;
			pmu_ac_vol = <0x1068>; //4200
			pmu_ac_cur = <0x7D0>; //2000
			pmu_usbpc_vol = <0x125C>; //4700
			pmu_usbpc_cur = <0x1f4>; //500
			pmu_battery_warning_level1 = <0xf>;
			pmu_battery_warning_level2 = <0x0>;
			pmu_chgled_func = <0x0>;
			pmu_chgled_type = <0x0>;
			power_start = <0x0>;
			pmu_ocv_en = <0x1>;
			pmu_cou_en = <0x1>;
			pmu_update_min_time = <0x1e>;
			pmu_bat_para1 = <0x0>;
			pmu_bat_para2 = <0x0>;
			pmu_bat_para3 = <0x0>;
			pmu_bat_para4 = <0x0>;
			pmu_bat_para5 = <0x02>;
			pmu_bat_para6 = <0x03>;
			pmu_bat_para7 = <0x03>;
			pmu_bat_para8 = <0x05>;
			pmu_bat_para9 = <0x7>;
			pmu_bat_para10 = <0x0A>;
			pmu_bat_para11 = <0x0E>;
			pmu_bat_para12 = <0x13>;
			pmu_bat_para13 = <0x1A>;
			pmu_bat_para14 = <0x23>;
			pmu_bat_para15 = <0x29>;
			pmu_bat_para16 = <0x2F>;
			pmu_bat_para17 = <0x34>;
			pmu_bat_para18 = <0x39>;
			pmu_bat_para19 = <0x40>;
			pmu_bat_para20 = <0x47>;
			pmu_bat_para21 = <0x4C>;
			pmu_bat_para22 = <0x4F>;
			pmu_bat_para23 = <0x52>;
			pmu_bat_para24 = <0x53>;
			pmu_bat_para25 = <0x55>;
			pmu_bat_para26 = <0x57>;
			pmu_bat_para27 = <0x5A>;
			pmu_bat_para28 = <0x5B>;
			pmu_bat_para29 = <0x5E>;
			pmu_bat_para30 = <0x60>;
			pmu_bat_para31 = <0x63>;
			pmu_bat_para32 = <0x64>;
			pmu_bat_temp_enable = <0x01>;
			//NTC R---C=R * 60ma
			pmu_bat_charge_ltf = <0x848>; //0
			pmu_bat_charge_htf = <0x104>; //55
			pmu_bat_shutdown_ltf = <0xD89>; //-15
			pmu_bat_shutdown_htf = <0xDE>; //60
			pmu_bat_temp_para1 = <0x1C5F>;
			pmu_bat_temp_para2 = <0x10E1>;
			pmu_bat_temp_para3 = <0xD34>;
			pmu_bat_temp_para4 = <0xA69>;
			pmu_bat_temp_para5 = <0x848>;
			pmu_bat_temp_para6 = <0x6A1>;
			pmu_bat_temp_para7 = <0x55A>;
			pmu_bat_temp_para8 = <0x38F>;
			pmu_bat_temp_para9 = <0x26C>;
			pmu_bat_temp_para10 = <0x1B0>;
			pmu_bat_temp_para11 = <0x16B>;
			pmu_bat_temp_para12 = <0x133>;
			pmu_bat_temp_para13 = <0x104>;
			pmu_bat_temp_para14 = <0xDE>;
			pmu_bat_temp_para15 = <0xA3>;
			pmu_bat_temp_para16 = <0x7A>;
		};
	};
};
