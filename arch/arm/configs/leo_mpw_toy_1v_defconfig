## arch/arm/configs/leo_mpw_toy_1v_defconfig
```kconfig
# CONFIG_LOCALVERSION_AUTO is not set
CONFIG_SYSVIPC=y
CONFIG_FHANDLE=y
CONFIG_HIGH_RES_TIMERS=y
CONFIG_IKCONFIG=y
CONFIG_IKCONFIG_PROC=y
CONFIG_LOG_BUF_SHIFT=14
CONFIG_CGROUPS=y
CONFIG_CPUSETS=y
CONFIG_NAMESPACES=y
CONFIG_EMBEDDED=y
CONFIG_PROFILING=y
CONFIG_OPROFILE=y
CONFIG_MODULES=y
CONFIG_MODULE_UNLOAD=y
# CONFIG_LBDAF is not set
# CONFIG_BLK_DEV_BSG is not set
# CONFIG_IOSCHED_DEADLINE is not set
# CONFIG_IOSCHED_CFQ is not set
# CONFIG_CACHE_L2X0 is not set
CONFIG_ARCH_LEO=y
CONFIG_ARM_THUMBEE=y
CONFIG_AEABI=y
CONFIG_CMA=y
CONFIG_ZBOOT_ROM_TEXT=0x0
CONFIG_ZBOOT_ROM_BSS=0x0
CONFIG_VFP=y
CONFIG_NEON=y
CONFIG_NET=y
CONFIG_PACKET=y
CONFIG_UNIX=y
CONFIG_NET_KEY=y
CONFIG_NET_KEY_MIGRATE=y
CONFIG_INET=y
CONFIG_IP_MULTICAST=y
CONFIG_IP_PNP=y
CONFIG_IP_PNP_DHCP=y
CONFIG_IP_PNP_BOOTP=y
CONFIG_IP_PNP_RARP=y
CONFIG_IPV6=y
CONFIG_NETWORK_PHY_TIMESTAMPING=y
CONFIG_VLAN_8021Q=y
CONFIG_VLAN_8021Q_GVRP=y
CONFIG_CAN=y
CONFIG_CAN_C_CAN=y
CONFIG_CAN_C_CAN_PLATFORM=y
CONFIG_CAN_DEBUG_DEVICES=y
CONFIG_UEVENT_HELPER_PATH="/sbin/hotplug"
CONFIG_DEVTMPFS=y
CONFIG_DEVTMPFS_MOUNT=y
CONFIG_DMA_CMA=y
CONFIG_CMA_SIZE_MBYTES=32
CONFIG_BLK_DEV_RAM=y
CONFIG_BLK_DEV_RAM_COUNT=2
CONFIG_BLK_DEV_RAM_SIZE=8192
CONFIG_SRAM=y
CONFIG_BLK_DEV_SD=y
CONFIG_NETDEVICES=y
CONFIG_STMMAC_ETH=y
CONFIG_MICREL_PHY=y
CONFIG_INPUT_EVDEV=y
# CONFIG_SERIO_SERPORT is not set
CONFIG_SERIO_AMBAKMI=y
CONFIG_LEGACY_PTY_COUNT=16
CONFIG_SERIAL_8250=y
CONFIG_SERIAL_8250_CONSOLE=y
CONFIG_SERIAL_8250_NR_UARTS=2
CONFIG_SERIAL_8250_RUNTIME_UARTS=2
CONFIG_SERIAL_8250_DW=y
CONFIG_I2C=y
CONFIG_I2C_CHARDEV=y
CONFIG_I2C_DESIGNWARE_PLATFORM=y
CONFIG_GPIOLIB=y
CONFIG_GPIO_SYSFS=y
CONFIG_REGULATOR=y
CONFIG_REGULATOR_FIXED_VOLTAGE=y
CONFIG_USB=y
CONFIG_USB_USBNET=y
CONFIG_USB_EHCI_HCD=y
CONFIG_USB_EHCI_TT_NEWSCHED=y
CONFIG_USB_EHCI_HCD_PLATFORM=y
CONFIG_USB_OHCI_HCD=y
CONFIG_USB_OHCI_HCD_PLATFORM=y
CONFIG_MMC=y
CONFIG_MMC_DW=y
CONFIG_EXT2_FS=y
CONFIG_EXT2_FS_XATTR=y
CONFIG_EXT2_FS_POSIX_ACL=y
CONFIG_EXT3_FS=y
CONFIG_EXT4_FS=y
CONFIG_VFAT_FS=y
CONFIG_NTFS_FS=y
CONFIG_NTFS_RW=y
CONFIG_TMPFS=y
CONFIG_CONFIGFS_FS=y
CONFIG_NFS_FS=y
CONFIG_ROOT_NFS=y
CONFIG_NLS_CODEPAGE_437=y
CONFIG_NLS_ISO8859_1=y
CONFIG_PRINTK_TIME=y
CONFIG_DEBUG_INFO=y
CONFIG_MAGIC_SYSRQ=y
CONFIG_DETECT_HUNG_TASK=y
# CONFIG_SCHED_DEBUG is not set
CONFIG_ENABLE_DEFAULT_TRACERS=y
CONFIG_DEBUG_USER=y
CONFIG_XZ_DEC=y
CONFIG_CPU_FREQ=y
CONFIG_ARM_LEO_CPUFREQ=y
CONFIG_MTD=y
CONFIG_MTD_CMDLINE_PARTS=y
CONFIG_MTD_OF_PARTS=y
CONFIG_MTD_SPI_NAND=y
CONFIG_MTD_UBI=y
CONFIG_SPI=y
CONFIG_SPI_MASTER=y
CONFIG_SPI_DESIGNWARE=y
CONFIG_SPI_DW_MMIO=y
CONFIG_UBIFS_FS=y
CONFIG_UBIFS_FS_ADVANCED_COMPR=y
CONFIG_UBIFS_FS_LZO=y
CONFIG_UBIFS_FS_ZLIB=y
CONFIG_UBIFS_ATIME_SUPPORT=y
# CONFIG_NATIONALCHIP_GXAVDEV is not set
```

## arch/arm/mach-leo/Kconfig
```kconfig
menuconfig ARCH_LEO
	bool "Nationalchip leo family" if ARCH_MULTI_V7
	select HAVE_ARM_ARCH_TIMER
	select ARM_AMBA
	select ARM_NATIONALCHIP
	select PINCTRL

if ARCH_LEO
config LEO_SUSPEND
	bool "Suspend to RAM on LEO"
	help
	  Select this if you want to enable Suspend-to-RAM on LEO
	  platforms.

config K18_UNIVERSAL_SUPPORT
	bool "K18 Universal Family Boards support"
	default n
	help
	  Select this if you want to support K18_UNIVERSAL family boards

config K18_BOARD_NAME
	string "K18 Board name"
	default "gx8010_rkd_naboo"
	help
	  This option should contain the base name of Kamino18 product board.

endif
```

## arch/arm/mach-leo_mpw/Kconfig
```kconfig
menuconfig ARCH_LEO_MPW
	bool "Nationalchip leo mpw family" if ARCH_MULTI_V7
	select HAVE_ARM_ARCH_TIMER
	select NATIONALCHIP_TIMER
	select ARM_AMBA
	select ARM_NATIONALCHIP
	select PINCTRL

if ARCH_LEO_MPW
config LEO_MPW_SUSPEND
	bool "Suspend to RAM on LEO mpw"
	help
	  Select this if you want to enable Suspend-to-RAM on LEO
	  platforms.
endif
```

## drivers/misc/nationalchip/Kconfig
```kconfig
config NATIONALCHIP_COUNTER
	tristate "nationalchip counter"
	default	n
	help
	  Use nationalchip counter to achieve precise time management

config NATIONALCHIP_NPU
	tristate "nationalchip NPU"
	default	n
	help
	  This driver allows you to use NPU module to execute neural network.

config NATIONALCHIP_UART_MCTRL
	tristate "nationalchip uart flow control"
	default	n
	help
	  This driver allows you to use gpio to simulate uart flow control.

config NATIONALCHIP_OTP
	tristate "nationalchip otp"
	select MULTICORE_LOCK
	default	n
	help
	  This driver allows you to use otp.

menuconfig NATIONALCHIP_GXAVDEV
	tristate "nationalchip gxavdev modules select"
	default	n
	help
	  Use nationalchip gxavdev to achieve meida player

if NATIONALCHIP_GXAVDEV

config NATIONALCHIP_AUDIO_IN
	bool "nationalchip audio in"
	default	n

config NATIONALCHIP_AUDIO_PLAY
	bool "nationalchip audio play"
	default	n
	depends on NATIONALCHIP_GXALSA=n && NATIONALCHIP_GXASOC=n

config NATIONALCHIP_AUDIO_DECODE
	bool "nationalchip audio decode"
	default	n

config NATIONALCHIP_JPEG
	bool "nationalchip jpeg decode/encode"
	default	n

config NATIONALCHIP_CAMERA
	bool "nationalchip camera"
	default	n

config NATIONALCHIP_VPU
	bool "nationalchip vpu"
	default	n
endif
```

## drivers/mtd/spi-nand/Kconfig
```kconfig
menuconfig MTD_SPI_NAND
	tristate "SPI-NAND device support"
	depends on MTD
	help
	  This is the framework for the SPI NOR which can be used by the SPI
	  device drivers and the SPI-NOR device driver.
```

## drivers/multicore_lock/Kconfig
```kconfig
menu "MultiCore Lock Support"

config MULTICORE_LOCK
	bool "Enable support for NationChip Leo MultiCore Lock"
	default y
	depends on ARCH_LEO

endmenu
```

## drivers/pinctrl/nationalchip/Kconfig
```kconfig
#
# leo Pin control drivers
#

config PINCTRL_NATIONALCHIP
	bool
	default y
	select PINMUX
	select PINCONF
	select GPIOLIB_IRQCHIP

config PINCTRL_LEO_MPW
	bool "nationalchip LEO MPW pinctrl driver"
	depends on ARCH_LEO_MPW

config PINCTRL_LEO
	bool "nationalchip LEO pinctrl driver"
	depends on ARCH_LEO
```

## drivers/power/axp/Kconfig
```kconfig
menuconfig AW_AXP
	bool "AXP Power drivers"
	depends on REGULATOR
	#depends on ARCH_SUNXI
	select MFD_CORE
	help
	  This option allows you to select AXP power driver

if AW_AXP

config AXP_TWI_USED
	bool "AXP use twi as transfer channel"
	default y
	depends on I2C
	help
	  To use twi as transfer channel

config DUAL_AXP_USED
	bool "Support dual axp online"
        default n
	#depends on ARCH_SUN8IW10 || ARCH_SUN8IW15

config AW_AXP22X
	bool "AXP22x driver"
	#depends on ARCH_SUN8IW11 || ARCH_SUN8IW12 || ARCH_SUN8IW15
        default n
	help
	  AXP22x driver

config AW_AXP15060
    bool "AXP15060 driver"
   # depends on ARCH_SUN8IW15
   default n
    help
        AXP15060 driver

config AW_AXP152
    bool "AXP152 driver"
   # depends on ARCH_SUN8IW15
   default n
    help
        AXP152 driver

config AW_AXP2585
	bool "AXP2585 driver"
	#depends on ARCH_SUN8IW15
        default n
	help
	AXP2585 driver, AXP2585 is a BMU,which is just for battery power manager.
	We could use a BMU and a PMU for high voltage project.The BMU is good
	at manage battery, and the PMU could be a supplier of  periphrals.
	Say Y here to enable AXP2585 driver.


config AW_AXP233
	bool "AXP233 driver"
	#depends on ARCH_SUN8IW11 || ARCH_SUN8IW12
	default n
	help
	  AXP233 driver, compatible with AXP22X.

config AW_AXP80X
	bool "AXP80x driver"
	#depends on ARCH_SUN8IW12 || ARCH_SUN50IW6
        default n
	help
	  AXP80x driver

config AW_AXP2881
	bool "AXP2881 driver"
	#depends on ARCH_SUN50IW1 || ARCH_SUN50IW3 || ARCH_SUN8IW6
        default n
	help
	  AXP2881 driver
config XP_AXP2601
	bool "AXP2601 driver"
	#depends on ARCH_SUN50IW1 || ARCH_SUN50IW3 || ARCH_SUN8IW6
        default n
	help
	  AXP2601 is a discrete battery gauge for single /2 serial battery driver

endif # AW_AXP
```

## drivers/staging/yodabase/Kconfig
```kconfig
#
# yodabase configuration
#

config LIGHT_EFFECT
	tristate "Support light effect"
	default n
	help
		Light on when drive start,and export universal port.

config VAD_WAKELOCK
	bool "Support VAD wakelock adding when system resume"
	default n
	help
		Add wakelock timeout when system resume to give time for VAD
```

## sound/nationalchip/Kconfig
```kconfig
#
# nationalchip audio configuration
#

config NATIONALCHIP_GXALSA
	tristate "ALSA For Nationalchip"
	select SND_PCM
	default	n
	help
	  Use nationalchip gxalsa to achieve media player
```

## sound/soc/nationalchip/Kconfig
```kconfig
#
# nationalchip audio configuration
#

config SND_SOC_NATIONALCHIP
	tristate "ASoC support for Nationalchip"
	select SND_PCM
	default n
	depends on SND_NATIONALCHIP_PCM=n
	help
		Use nationalchip gxasoc to achieve media player
```
